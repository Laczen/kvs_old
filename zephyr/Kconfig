## zephyr/Kconfig
```kconfig
# Kconfig - key value store - kvs
#
# Copyright (c) 2022 Laczen
#
# SPDX-License-Identifier: Apache-2.0
#

config KVS
	bool "Key Value Store - kvs"
	help
	  Enable support of kvs.

if KVS

module = KVS
module-str = kvs
source "subsys/logging/Kconfig.template.log_config"

endif # SFCB
```

## zephyr/dts/bindings/misc/zephyr,kvs-eeprom.yaml
```yaml
# Copyright (c) 2023 Laczen
# SPDX-License-Identifier: Apache-2.0

description: Key Value Store on eeprom

compatible: "zephyr,kvs-eeprom"

include: base.yaml

properties:
  eeprom:
    type: phandle
    required: true
    description: |
      Backing storage eeprom.
  
  "#address-cells":
    const: 1

  "#size-cells":
    const: 1

  reg:
    type: array
    description: |
      The reg property specifies the address range of the eeprom to use when
      only a part of the eeprom is to be used for kvs storage.

  sector-size:
    type: int
    required: true
    description: |
      The sector-size specifies how to divide the eeprom into sectors. The 
      sector-size should be a power of 2.
  
  free-size:
    type: int
    description: |
      To ensure no data is lost during garbage collection some area should 
      always be free. This defaults to sector-size if omitted.
```

## zephyr/dts/bindings/misc/zephyr,kvs-flash.yaml
```yaml
# Copyright (c) 2023 Laczen
# SPDX-License-Identifier: Apache-2.0

description: Key Value Store on flash partition

compatible: "zephyr,kvs-flash"

include: base.yaml

properties:
  partition:
    type: phandle
    required: true
    description: |
      Backing storage flash partition.

  sector-size:
    type: int
    required: true
    description: |
      The sector-size specifies how to divide the flash partition into sectors.
      The sector-size should be a power of 2.

  free-size:
    type: int
    description: |
      To ensure no data is lost during garbage collection some area should 
      always be free. As flash needs to be erased before being written this size
      should at least be equal to the largest erase block size of the flash
      partition. Defaults to sector-size if omitted
```

## zephyr/subsys/kvs/Kconfig
```kconfig
# Subsystem configuration options

# Copyright (c) 2023 Laczen
# SPDX-License-Identifier: Apache-2.0

config KVS_BACKEND_FLASH
        bool "Enable KVS FLASH backend"
        depends on FLASH
        depends on FLASH_PAGE_LAYOUT
        help
          This enables the FLASH backend for key value storage (this can also
          be RAM by utilizing flash_simulator).

if KVS_BACKEND_FLASH
module = KVS_BACKEND_FLASH
module-str = kvs_backend_flash
source "subsys/logging/Kconfig.template.log_config"

endif #KVS_BACKEND_FLASH

config KVS_BACKEND_EEPROM
        bool "Enable KVS EEPROM backend"
        depends on EEPROM
        help
          This enables the EEPROM backend for key value storage

if KVS_BACKEND_EEPROM
module = KVS_BACKEND_EEPROM
module-str = kvs_backend_eeprom
source "subsys/logging/Kconfig.template.log_config"

endif #KVS_BACKEND_EEPROM
```
